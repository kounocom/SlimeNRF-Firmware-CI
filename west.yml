## west.yml
```yaml
manifest:
  version: "0.10"
  projects:

    # nRF-Connect SDK
    - name: sdk-nrf
      path: nrf
      url: https://github.com/nrfconnect/sdk-zephyr.git
      revision: main
      import: true

    # SlimeVR-Tracker-nRF-Receiver
    - name: SlimeVR-Tracker-nRF-Receiver
      url: https://github.com/SlimeVR/SlimeVR-Tracker-nRF-Receiver.git
      path: SlimeVR-Tracker-nRF-Receiver
      revision: tdma

    # SlimeVR-Tracker-nRF
    - name: SlimeVR-Tracker-nRF
      url: https://github.com/SlimeVR/SlimeVR-Tracker-nRF.git
      path: SlimeVR-Tracker-nRF
      revision: tdma

    # vqf-c
    - name: vqf-c
      url: https://github.com/sctanf/vqf-c.git
      path: SlimeVR-Tracker-nRF/vqf-c
      revision: master

    # Fusion
    - name: Fusion
      url: https://github.com/xioTechnologies/Fusion.git
      path: SlimeVR-Tracker-nRF/Fusion
      revision: main
      
    # NXP-ISSDK-SensorFusion
    - name: NXP-ISSDK-SensorFusion
      url: https://github.com/sctanf/NXP-ISSDK-SensorFusion.git
      path: SlimeVR-Tracker-nRF/NXP-ISSDK-SensorFusion
      revision: main
```
